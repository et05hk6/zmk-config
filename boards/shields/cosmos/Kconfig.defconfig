## boards/shields/cosmos/Kconfig.defconfig
```kconfig
if SHIELD_COSMOS_LEFT

# Name must be less than 16 characters long!
config ZMK_KEYBOARD_NAME
    default "My Cosmos"

config ZMK_SPLIT_ROLE_CENTRAL
    default y

CONFIG_ZMK_STUDIO=y

endif

if SHIELD_COSMOS_LEFT || SHIELD_COSMOS_RIGHT

config ZMK_SPLIT
    default y

endif
```
